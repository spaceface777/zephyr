## soc/native/inf_clock/Kconfig
```kconfig
# Copyright (c) 2023 Nordic Semiconductor ASA
# SPDX-License-Identifier: Apache-2.0

config SOC_POSIX
	select ARCH_POSIX
	select CPU_HAS_FPU
	select HAS_CPU_FREQ

if SOC_POSIX

config NATIVE_SIMULATOR_MCU_N
	int "CPU Number this image targets"
	range 0 15
	default 0
	help
	  Which native simulator microcontroller/CPU number is this image targeting.

config NATIVE_SIMULATOR_NUMBER_MCUS
	int "Total number of MCUs this target has"
	range 1 16
	default 1
	help
	  How many AMP MCUs does this target have in total.

config NATIVE_SIMULATOR_PRIMARY_MCU_INDEX
	int "Which CPU is the primary/preferred"
	default 0
	help
	  On a multi MCU device, which MCU is the preferred one.
	  This MCU will for example have its tests command line parameters presented
	  without any prefix. Note that an MCU being primary does not imply it will be
	  the first one to boot, or even that it will boot automatically.

config NATIVE_SIMULATOR_EXTRA_IMAGE_PATHS
	string "Other cores images to include"
	help
	  This option can be used to provide the native simulator with other MCUs/Cores images which have
	  been produced by either other Zephyr builds or different OS builds.
	  So you can, for ex., use this application build to produce one core image, and at the same time
	  have it produce the final link with the native simulator runner and the other MCU images.

config NATIVE_SIMULATOR_AUTOSTART_MCU
	bool "Auto-start this MCU"
	help
	  Automatically start the MCU this Zephyr image is built for during HW boot,
	  even if in other circumstances this MCU would not start automatically (for ex. because
	  another core is meant to release its reset).
	  If that MCU was, by HW design, going to start at HW boot anyhow, this option does nothing.
	  This option is meant to facilitate development.

config NATIVE_SIMULATOR_STATIC_LINKING
	bool "Attempt to use static linking"
	help
	  Do not link the final native simulator runner with shared libraries.

	  Static linking depends on all required libraries being available as static libraries.

choice NATIVE_SIMULATOR_NCT_BACKEND
	prompt "Embedded thread (NCT) emulation"
	default NATIVE_SIMULATOR_NCT_BACKEND_PTHREADS

config NATIVE_SIMULATOR_NCT_BACKEND_PTHREADS
	bool "Host threads"
	help
	  Run each embedded OS thread in its own host thread.

config NATIVE_SIMULATOR_NCT_BACKEND_COROUTINES
	bool "Coroutines"
	depends on NATIVE_SIMULATOR_NUMBER_MCUS = 1
	help
	  Run the embedded OS threads as stackful coroutines on one host thread.
	  The embedded OS still decides which thread runs next; NCT only performs
	  the requested context transfer.

endchoice

choice NATIVE_SIMULATOR_NCE_BACKEND
	prompt "CPU start/stop (NCE) emulation"
	default NATIVE_SIMULATOR_NCE_BACKEND_PTHREADS

config NATIVE_SIMULATOR_NCE_BACKEND_PTHREADS
	bool "Host thread"
	help
	  Run the embedded CPU on a host thread and hand execution between the
	  hardware models and embedded software with host synchronization.

config NATIVE_SIMULATOR_NCE_BACKEND_COROUTINES
	bool "Coroutine"
	depends on NATIVE_SIMULATOR_NUMBER_MCUS = 1
	depends on NATIVE_SIMULATOR_NCT_BACKEND_COROUTINES
	help
	  Run the CPU/HW handoff as a stackful coroutine switch on the same host
	  thread as the hardware models.

	  Coroutine NCE requires coroutine NCT. pthread NCT moves the running
	  embedded software to another host thread, after which a same-thread
	  stackful switch cannot resume the hardware/root context.

endchoice

choice NATIVE_SIMULATOR_COROUTINE_IMPLEMENTATION
	prompt "Stackful coroutine primitive"
	depends on NATIVE_SIMULATOR_NCT_BACKEND_COROUTINES
	default NATIVE_SIMULATOR_COROUTINE_IMPLEMENTATION_ASM

config NATIVE_SIMULATOR_COROUTINE_IMPLEMENTATION_ASM
	bool "Minimal architecture-specific switch"
	help
	  Use the small native_sim assembly switch which saves the host ABI's
	  callee-saved state and changes stacks directly.
	  Supported on x86-64 SysV, i386 SysV and AArch64 AAPCS64.

config NATIVE_SIMULATOR_COROUTINE_IMPLEMENTATION_UCONTEXT
	bool "ucontext"
	help
	  Use getcontext(), makecontext() and swapcontext() from the host C
	  library. This requires a host libc which still provides the historical
	  ucontext API.

config NATIVE_SIMULATOR_COROUTINE_IMPLEMENTATION_BOOST_CONTEXT
	bool "Boost.Context fcontext"
	help
	  Use Boost.Context's low-level fcontext primitive. Selecting this option
	  adds a host build dependency on Boost.Context.

endchoice

endif # SOC_POSIX
```

## tests/boards/native_sim/fibers/Kconfig
```kconfig
# SPDX-FileCopyrightText: Copyright The Zephyr Project Contributors
# SPDX-License-Identifier: Apache-2.0
source "Kconfig.zephyr"

config TEST_FIBER_WRONG_OWNER
	bool "Call the context manager from a foreign thread"

config TEST_FIBER_BORROWED_ROOT
	bool "Borrow a zero-FP-flag root before backend attachment"
```
